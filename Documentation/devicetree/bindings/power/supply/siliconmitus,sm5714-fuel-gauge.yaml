## Documentation/devicetree/bindings/power/supply/siliconmitus,sm5714-fuel-gauge.yaml
```yaml
# SPDX-License-Identifier: GPL-2.0-only OR BSD-2-Clause
%YAML 1.2
---
$id: http://devicetree.org/schemas/power/supply/siliconmitus,sm5714-fuel-gauge.yaml#
$schema: http://devicetree.org/meta-schemas/core.yaml#

title: Silicon Mitus SM5714 fuel gauge

maintainers:
  - rafroad <rafan.second@gmail.com>

description:
  The fuel gauge of the SM5714 charger and power management chip. The
  charger block of the same chip answers at I2C address 0x49 on the same
  bus; the driver reads its status from there.

allOf:
  - $ref: power-supply.yaml#

properties:
  compatible:
    const: siliconmitus,sm5714-fuel-gauge

  reg:
    maxItems: 1

required:
  - compatible
  - reg

unevaluatedProperties: false

examples:
  - |
    i2c {
        #address-cells = <1>;
        #size-cells = <0>;

        fuel-gauge@71 {
            compatible = "siliconmitus,sm5714-fuel-gauge";
            reg = <0x71>;
        };
    };
...
```
